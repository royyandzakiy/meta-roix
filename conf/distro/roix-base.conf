## conf/distro/roix.conf
```bitbake
require conf/distro/poky.conf

DISTRO = "roix"
DISTRO_NAME = "Roy Linux"
DISTRO_VERSION = "1.0"
DISTRO_CODENAME = "scarthgap"

INIT_MANAGER = "systemd"

# Distro features — lean set for a headless RPi4
DISTRO_FEATURES = "acl argp bluetooth ext2 ipv4 ipv6 \
                   largefile pam seccomp systemd \
                   usbhost wifi xattr zeroconf"

DISTRO_FEATURES_BACKFILL_CONSIDERED += "sysvinit"
VIRTUAL-RUNTIME_init_manager = "systemd"
VIRTUAL-RUNTIME_initscripts = "systemd-compat-units"
VIRTUAL-RUNTIME_login_manager = "shadow-base"

PREFERRED_PROVIDER_virtual/kernel = "linux-raspberrypi"

IMAGE_LINGUAS = "en-us"

DISTRO_EXTRA_RDEPENDS += ""
DISTRO_EXTRA_RRECOMMENDS += ""
```

## conf/layer.conf
```bitbake
BBPATH .= ":${LAYERDIR}"
BBFILES += "${LAYERDIR}/recipes-*/*/*.bb \
            ${LAYERDIR}/recipes-*/*/*.bbappend"

BBFILE_COLLECTIONS += "meta-roix"
BBFILE_PATTERN_meta-roix = "^${LAYERDIR}/"
BBFILE_PRIORITY_meta-roix = "10"

LAYERDEPENDS_meta-roix = "core raspberrypi"
LAYERSERIES_COMPAT_meta-roix = "scarthgap"
```

## conf/machine/raspberrypi4-64-roix.conf
```bitbake
require conf/machine/raspberrypi4-64.conf

ENABLE_UART = "1"
SERIAL_CONSOLES = "115200;ttyS0"
RPI_EXTRA_CONFIG += "dtparam=uart0_console"

ENABLE_I2C = "1"
ENABLE_SPI = "1"

# eth0 via USB-Ethernet on RPi4 (smsc95xx)
KERNEL_MODULE_AUTOLOAD:append = " smsc95xx"

LICENSE_FLAGS_ACCEPTED = "synaptics-killswitch"

BB_NUMBER_THREADS ?= "2"
PARALLEL_MAKE ?= "-j 2"
```
